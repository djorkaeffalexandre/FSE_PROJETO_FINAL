## energia/main/Kconfig.projbuild
```kconfig
menu "Wifi Configuration"
  config ESP_WIFI_SSID
    string "WiFi SSID"
    default "ssid"
    help
      Nome da rede Wifi.

  config ESP_WIFI_PASSWORD
    string "Senha do Wifi"
    default "minha_senha"
    help
      Senha do WiFi (WPA or WPA2).
endmenu

menu "FSE Configuration"
  config ESP_STUDENT_ID
    string "Matrícula do estudante"
    default "matricula"
    help
      Matricula do estudante.
endmenu
```

## esp/main/Kconfig.projbuild
```kconfig
menu "Wifi Configuration"
  config ESP_WIFI_SSID
    string "WiFi SSID"
    default "ssid"
    help
      Nome da rede Wifi.

  config ESP_WIFI_PASSWORD
    string "Senha do Wifi"
    default "minha_senha"
    help
      Senha do WiFi (WPA or WPA2).
endmenu

menu "FSE Configuration"
  choice ESP_MODEL_TYPE
    prompt "Modo de alimentação da ESP"
    default ESP_MODEL_TYPE_ENERGY
    config ESP_MODEL_TYPE_ENERGY
      bool "ENERGY"
    config ESP_MODEL_TYPE_BATTERY
      bool "BATTERY"
    help
      Configuração do modo de alimentação da ESP.
  endchoice
  config ESP_STUDENT_ID
    int "Matrícula do estudante"
    default 000000000
    help
      Matricula do estudante.
endmenu
```
